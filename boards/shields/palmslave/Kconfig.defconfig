## boards/shields/palmslave/Kconfig.defconfig
```kconfig
if SHIELD_PALMSLAVE_LEFT

config ZMK_SPLIT_ROLE_CENTRAL
    default y

endif

if SHIELD_PALMSLAVE_LEFT || SHIELD_PALMSLAVE_RIGHT

config ZMK_KEYBOARD_NAME
    default "palmslave"

config ZMK_SPLIT
    default y


endif
```

## boards/shields/palmslave/Kconfig.shield
```kconfig
config SHIELD_PALMSLAVE_LEFT
    def_bool $(shields_list_contains,palmslave_left)

config SHIELD_PALMSLAVE_RIGHT
    def_bool $(shields_list_contains,palmslave_right)
```

## config/west.yml
```yaml
manifest:
  remotes:
    - name: zmkfirmware
      url-base: https://github.com/zmkfirmware
    - name: sekigon-gonnoc
      url-base: https://github.com/sekigon-gonnoc
    - name: pasokata
      url-base: https://github.com/pasokata
  projects:
    - name: zmk
      remote: zmkfirmware
      revision: main
      import: app/west.yml
    - name: zmk-component-ble-micro-pro
      remote: sekigon-gonnoc
      revision: main
    - name: zmk-behavior-swapper
      remote: pasokata
      revision: main
  self:
    path: config
```
