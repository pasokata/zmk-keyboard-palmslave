#include "palmslave.dtsi"

&kscan0 {
    col-gpios
        = <&bmp 7 GPIO_ACTIVE_HIGH>
        , <&bmp 8 GPIO_ACTIVE_HIGH>
        , <&bmp 9 GPIO_ACTIVE_HIGH>
        , <&bmp 10 GPIO_ACTIVE_HIGH>
        , <&bmp 11 GPIO_ACTIVE_HIGH>
        ;
};